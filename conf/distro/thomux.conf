## conf/distro/thomux.conf
```bitbake
require conf/distro/poky.conf

DISTRO = "thomux"
DISTRO_NAME = "Thomux (Distro for Odriod XU4 Homeserver)"
DISTRO_VERSION = "0.1.0"
DISTRO_CODENAME = "thomux-honister"
SDK_VENDOR = "-thmouxsdk"

MAINTAINER = "Thomux <me@thmoux.eu>"

# Use Systemd

DISTRO_FEATURES:append = " systemd"
DISTRO_FEATURES_BACKFILL_CONSIDERED += "sysvinit"
VIRTUAL-RUNTIME_init_manager = "systemd"
VIRTUAL-RUNTIME_initscripts = "systemd-compat-units"
```

## conf/layer.conf
```bitbake
# We have a conf and classes directory, add to BBPATH
BBPATH .= ":${LAYERDIR}"

# We have recipes-* directories, add to BBFILES
BBFILES += "${LAYERDIR}/recipes-*/*/*.bb \
            ${LAYERDIR}/recipes-*/*/*.bbappend"

BBFILE_COLLECTIONS += "meta-thomux"
BBFILE_PATTERN_meta-thomux = "^${LAYERDIR}/"
BBFILE_PRIORITY_meta-thomux = "6"

LAYERDEPENDS_meta-thomux = "core"
LAYERSERIES_COMPAT_meta-thomux = "honister"
```
